## config/west.yml
```yaml
manifest:
  remotes:
    - name: zmkfirmware
      url-base: https://github.com/zmkfirmware
    # custom gem view
    - name: chyuuu
      url-base: https://github.com/chyuuu
    #- name: m165437 #new entry
      #url-base: https://github.com/M165437 #new entry
  projects:
    - name: zmk
      remote: zmkfirmware
      revision: main
      import: app/west.yml
    # custom gem view
    - name: nice-view-bunbun
      remote: chyuuu
      revision: master
      path: nice-view-gem
    #- name: nice-view-gem #new entry
     # remote: m165437 #new entry
      #revision: main #new entry
  self:
    path: config
```
